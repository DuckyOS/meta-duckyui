## conf/layer.conf
```bitbake
BBPATH ?= ""
# We have a conf and classes directory, add to BBPATH
BBPATH .= ":${LAYERDIR}"
# We have recipe directories, add to BBFILES
BBFILES += "${LAYERDIR}/recipes-*/*/*.bb ${LAYERDIR}/recipes-*/*/*.bbappend"

BBFILE_COLLECTIONS += "meta-duckyui"
BBFILE_PATTERN_meta-duckyui := "^${LAYERDIR}/"
BBFILE_PRIORITY_meta-duckyui = "20"

LAYERSERIES_COMPAT_meta-duckyui = "kirkstone"

LAYERDEPENDS_meta-duckyui = "\
  meta-duckyos \
"

# LICENSE_PATH += "${LAYERDIR}/licenses"
```
